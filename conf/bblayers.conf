## conf/bblayers.conf
```bitbake
# POKY_BBLAYERS_CONF_VERSION is increased each time build/conf/bblayers.conf
# changes incompatibly
POKY_BBLAYERS_CONF_VERSION = "2"

BBPATH = "${TOPDIR}"
BBFILES ?= ""

BBLAYERS ?= " \
  /home/chez/dev/yocto/tegra/tk1/jetsontk1-yocto/meta-tegra \
  /home/chez/dev/yocto/tegra/tk1/jetsontk1-yocto/poky/meta \
  /home/chez/dev/yocto/tegra/tk1/jetsontk1-yocto/poky/meta-poky \
  /home/chez/dev/yocto/tegra/tk1/jetsontk1-yocto/poky/meta-yocto-bsp \
  "
```
